## chicken-coop-esp/main/Kconfig.projbuild
```kconfig
menu "Chicken Coop Configuration"

    config DEFAULT_FULL_OPEN_CLOSE_DURATION
        int "Open/Close duration [s]"
        range 50 1000
        default 60
        help
            Full duration to open or close the door in seconds

    config INVERT_MOTOR_DIRECTION
        bool "Invert motor direction"
        default False
        help
            Maps the motor direction to whether the door is opened or closed

    config START_IN_MANUAL_MODE
        bool "Start in manual mode. Useful for debugging"
        default False
        help
            Start in manual mode. Useful for debugging

    config INVERT_DOOR_STATE_SWITCH
        bool "Invert the functions determining whether the door is opened or closed"
        default False
        help
            Useful for hardware configuration changes

    config I2C_SDA_PORT
        int "GPIO port for the I2C SDA"
        range 0 48
        default 0
    config I2C_SCL_PORT
        int "GPIO port for the I2C SCL"
        range 0 48
        default 1

    config DOOR_SWITCH_STATE_PORT
        int "GPIO port to detect door state"
        range 0 48
        default 2
        help
            A switch should be connected at this port, indicating whether the door
            is opened or closed

    config MOTOR_PORT_0
        int "GPIO port for driving the motor in one direction"
        range 0 48
        default 4
    config MOTOR_PORT_1
        int "GPIO port for driving the motor in another direction"
        range 0 48
        default 5

    config COM_UART_RX
        int "GPIO port for the UART RX pin"
        range 0 48
        default 19
        help
            Can be used for communication with the ESP32
    config COM_UART_TX
        int "GPIO port for the UART TX pin"
        range 0 48
        default 18
        help
            Can be used for communication with the ESP32

    choice BLINK_LED
        prompt "Blink LED type"
        default BLINK_LED_GPIO if IDF_TARGET_ESP32
        default BLINK_LED_RMT
        help
            Defines the default peripheral for blink example

        config BLINK_LED_GPIO
            bool "GPIO"
        config BLINK_LED_RMT
            bool "RMT - Addressable LED"
    endchoice

    config BLINK_LED_RMT_CHANNEL
        depends on BLINK_LED_RMT
        int "RMT Channel"
        range 0 7
        default 0
        help
            Set the RMT peripheral channel.
            ESP32 RMT channel from 0 to 7
            ESP32-S2 RMT channel from 0 to 3
            ESP32-S3 RMT channel from 0 to 3
            ESP32-C3 RMT channel from 0 to 1

    config BLINK_GPIO
        int "Blink GPIO number"
        range 0 48
        default 8 if IDF_TARGET_ESP32C3 || IDF_TARGET_ESP32H2
        default 18 if IDF_TARGET_ESP32S2
        default 48 if IDF_TARGET_ESP32S3
        default 5
        help
            GPIO number (IOxx) to blink on and off or the RMT signal for the addressable LED.
            Some GPIOs are used for other purposes (flash connections, etc.) and cannot be used to blink.

    config BLINK_PERIOD
        int "Blink period in ms"
        range 10 3600000
        default 1000
        help
            Define the blinking period in milliseconds.

endmenu
```
